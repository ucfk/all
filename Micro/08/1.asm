	ORG	0000H
	LEFT	EQU 91H
	RIGHT	EQU 92H
	SEG	EQU P2
	STATE	EQU 30H ; RAM
	JMP	START
	ORG	0013H ; interrupt INT1 P3.3
	AJMP	ISR
	
START:
	MOV	STATE,#00H
	
	SETB	EA
	SETB	EX1
	SETB	IT1
MAIN_LOOP1:
	MOV	A,STATE
	JZ	SHOW_TOP
	JMP	SHOW_BOTTOM
SHOW_TOP:
	;a,b,f,g
	MOV	SEG,#01100011B
	CLR	LEFT
	CLR	RIGHT
	CALL	DELAY
	 ; OFF
  	MOV	SEG,#00000000B
  	CALL 	DELAY
	JMP	MAIN_LOOP1
SHOW_BOTTOM:
	;c,d,e,g
	MOV	SEG,#01011100B
	CLR	LEFT
	CLR	RIGHT
	CALL	DELAY
	MOV	SEG,#00000000B
  	CALL 	DELAY
	JMP	MAIN_LOOP1
ISR: ; interrupt service routine
	PUSH	ACC
	MOV	A,STATE
	CPL	A
	ANL	A,#01H
	MOV	STATE,A
	
	POP	ACC
	RETI ; back to work
DELAY:
	MOV	R2,#200
D1:	MOV	R1,#200
D2:	DJNZ	R1,D2
	DJNZ	R2,D1
	RET
	END