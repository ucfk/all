#include <Keypad.h>
#include <LedControl.h>

/*
  U1: ESP32 อ่าน Keypad แล้วแสดงผลบน 8x8 Dot-matrix ผ่าน MAX7219

  การต่อวงจร:
  - แถวของ 4x4 keypad = GPIO13,12,14,27
  - คอลัมน์ของ 4x4 keypad = GPIO26,25,33,32
  - MAX7219 DIN/CLK/CS = GPIO23,18,5

  การทำงาน:
  - กดปุ่ม 0-F บน keypad
  - ตัวอักษร hex ที่กดจะแสดงบน dot-matrix และค้างไว้จนกว่าจะกดปุ่มใหม่

  จุดที่แก้ได้:
  - rowPins/colPins ถ้าต่อสาย keypad ไม่ตรงกับโค้ด
  - glyphs[] ถ้าต้องการเปลี่ยนรูปตัวอักษรบน dot-matrix
*/

// MAX7219: DIN=23, CLK=18, CS=5 ถ้าต่อสายต่างจากนี้ให้แก้เลขพินตรงนี้
LedControl matrix(23, 18, 5, 1);

const byte ROWS = 4;
const byte COLS = 4;
char keys[ROWS][COLS] = {
  {'1', '2', '3', 'A'},
  {'4', '5', '6', 'B'},
  {'7', '8', '9', 'C'},
  {'E', '0', 'F', 'D'}
};
byte rowPins[ROWS] = {13, 12, 14, 27};
byte colPins[COLS] = {26, 25, 33, 32};
Keypad keypad = Keypad(makeKeymap(keys), rowPins, colPins, ROWS, COLS);

const byte glyphs[16][8] = {
  {0x3C,0x66,0x6E,0x76,0x66,0x66,0x3C,0x00},
  {0x18,0x38,0x18,0x18,0x18,0x18,0x7E,0x00},
  {0x3C,0x66,0x06,0x0C,0x30,0x60,0x7E,0x00},
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  {0x7E,0x60,0x60,0x7C,0x60,0x60,0x60,0x00}
};

int hexValue(char key) {
  // แปลงตัวอักษรจาก keypad เป็นค่า 0..15 ถ้าไม่มีปุ่มหรือไม่ถูกต้องจะคืนค่า -1
  if (key >= '0' && key <= '9') return key - '0';
  if (key >= 'A' && key <= 'F') return key - 'A' + 10;
  return -1;
}

void showGlyph(byte value) {
  // เขียนข้อมูลครบ 8 แถวลง MAX7219 แล้วภาพจะค้างอยู่จนกว่าจะเขียนค่าใหม่
  for (byte row = 0; row < 8; row++) {
    matrix.setRow(0, row, glyphs[value][row]);
  }
}

void setup() {
  matrix.shutdown(0, false);
  matrix.setIntensity(0, 8);
  matrix.clearDisplay(0);
  showGlyph(0);
}

void loop() {
  // getKey() คืนค่า 0 เมื่อไม่กดปุ่ม จึงไม่เปลี่ยนภาพเดิมบนจอ
  char key = keypad.getKey();
  int value = hexValue(key);
  if (value >= 0) showGlyph((byte)value);
}
